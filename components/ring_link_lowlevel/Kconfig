## components/ring_link_lowlevel/Kconfig
```kconfig
menu "Ring Link Lowlevel Configuration"
    choice RING_LINK_LOWLEVEL_IMPL
        prompt "Lowlevel Implementation"
        default RING_LINK_LOWLEVEL_IMPL_SPI

    config RING_LINK_LOWLEVEL_IMPL_SPI
        bool "SPI"

    config RING_LINK_LOWLEVEL_IMPL_UART
        bool "UART"

    endchoice
endmenu
```
